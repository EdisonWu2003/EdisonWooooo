// C++ code
//

byte btn;
byte pins[7] = {13,12,11,10,9,8,7};
byte show[17][7]=
{
    {0,0,0,0,0,0,1},//0
    {1,0,0,1,1,1,1},//1
    {0,0,1,0,0,1,0},//2
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    {1,1,1,1,1,1,1},//X
};

void setup()
{
  
  for(byte i = 0;i<7;++i)
  {
    pinMode(pins[i],OUTPUT);
  }
  pinMode(6, INPUT_PULLUP);
}

void loop()
{
  for(byte i = 0;i < 16;i++)
  {
    btn = digitalRead(6);
    if(btn == LOW)
  {
      for(byte j = 0; j < 7;j++)
        {
          digitalWrite(pins[j],1);
        }
  }else
    {
      for(byte j = 0; j < 7;j++)
        {
          digitalWrite(pins[j],show[i][j]);
        }
    }
    delay(1000);
  }
}
